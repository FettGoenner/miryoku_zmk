// Copyright 2023 Manna Harbour
// https://github.com/manna-harbour/miryoku

#include "../miryoku/custom_config.h"
#include "../miryoku/mapping/36/minidox.h"
#include "../miryoku/miryoku.dtsi"
#include "keys_de.h"

/ {
    combos {
        compatible = "zmk,combos";
        combo_enter_base {
            timeout-ms = <50>;
            key-positions = <34 35>;
            bindings = <&to 0>;
        };
        combo_shift {
            timeout-ms = <50>;
            key-positions = <33 36>;
            bindings = <&kp LSHIFT>;
        };
    };
};
