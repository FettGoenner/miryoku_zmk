// Copyright 2021 Manna Harbour
// https://github.com/manna-harbour/miryoku

#include "../miryoku/custom_config.h"
#include "../miryoku/mapping/42/corne.h"
#include "../miryoku/miryoku.dtsi"
#include "keys_de.h"

/ {
    combos {
        compatible = "zmk,combos";
        combo_enter_base {
            timeout-ms = <50>;
            key-positions = <38 39>;
            bindings = <&to 0>;
        };
        combo_shift {
            timeout-ms = <50>;
            key-positions = <37 40>;
            bindings = <&kp LSHIFT>;
        };
    };
};
