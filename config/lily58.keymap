// Copyright 2021 Manna Harbour
// https://github.com/manna-harbour/miryoku

#include "../miryoku/custom_config.h"
#include "../miryoku/mapping/58/lily58.h"
#include "../miryoku/miryoku.dtsi"
#include "keys_de.h"

/ {
    combos {
        compatible = "zmk,combos";
        combo_enter_base {
            timeout-ms = <50>;
            key-positions = <53 54>;
            bindings = <&to 0>;
        };
    };
};
